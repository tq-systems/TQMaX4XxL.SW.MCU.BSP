/**
 * @cliArgs --device "AM64x_beta" --package "ALV" --part "Default" --context "r5fss0-0" --product "MCU_PLUS_SDK_AM64x@08.06.00"
 * @versions {"tool":"1.14.0+2667"}
 */

/**
 * Import the modules used in this configuration.
 */
const flash       = scripting.addModule("/board/flash/flash", {}, false);
const flash1      = flash.addInstance();
const bootloader  = scripting.addModule("/drivers/bootloader/bootloader", {}, false);
const bootloader1 = bootloader.addInstance();
const mmcsd       = scripting.addModule("/drivers/mmcsd/mmcsd", {}, false);
const mmcsd1      = mmcsd.addInstance();
const uart        = scripting.addModule("/drivers/uart/uart", {}, false);
const uart1       = uart.addInstance();
const clock       = scripting.addModule("/kernel/dpl/clock");
const debug_log   = scripting.addModule("/kernel/dpl/debug_log");
const mpu_armv7   = scripting.addModule("/kernel/dpl/mpu_armv7", {}, false);
const mpu_armv71  = mpu_armv7.addInstance();
const mpu_armv72  = mpu_armv7.addInstance();
const mpu_armv73  = mpu_armv7.addInstance();
const mpu_armv74  = mpu_armv7.addInstance();
const mpu_armv75  = mpu_armv7.addInstance();

/**
 * Write custom configuration values to the imported modules.
 */
flash1.$name                         = "CONFIG_FLASH0";
flash1.flashBlockSize                = 65536;
flash1.cmdBlockErase3B               = "0xD8";
flash1.cmdWr                         = "0x02";
flash1.proto_isAddrReg               = false;
flash1.xspiWipRdCmd                  = "0x00";
flash1.xspiWipReg                    = "0x00000000";
flash1.quirks                        = "NULL";
flash1.dummyClksCmd                  = 0;
flash1.cmdSectorErase4B              = "0xDC";
flash1.cmdSectorErase3B              = "0xD8";
flash1.device                        = "CUSTOM_FLASH";
flash1.fname                         = "TQFLASH";
flash1.enable4BAddr                  = false;
flash1.dummy_cmdRegRd                = "0x15";
flash1.dummy_cmdRegWr                = "0x01";
flash1.dummy_isAddrReg               = false;
flash1.flashManfId                   = "0xC2";
flash1.flashDeviceId                 = "0x253A";
flash1.dummyClksRd                   = 10;
flash1.dummy_bitP                    = 192;
flash1.dummy_mask                    = "0xC0";
flash1.flashQeType                   = "2";
flash1.flash444Seq                   = "0x04";
flash1.protocol                      = "4s_4d_4d";
flash1.cmdRd                         = "0xED";
flash1.strDtr_isAddrReg              = false;
flash1.peripheralDriver.$name        = "CONFIG_OSPI0";
flash1.peripheralDriver.baudRateDiv  = 8;
flash1.peripheralDriver.inputClkFreq = 200000000;

bootloader1.$name          = "CONFIG_BOOTLOADER0";
bootloader1.appImageOffset = "0x80000";
bootloader1.bootMedia      = "MEM";

mmcsd1.$name        = "CONFIG_MMCSD0";
mmcsd1.moduleSelect = "MMC0";
mmcsd1.cardType     = "NO_DEVICE";

uart1.$name      = "CONFIG_UART0";
uart1.intrEnable = "DISABLE";

debug_log.enableLogZoneInfo = true;

mpu_armv71.$name             = "CONFIG_MPU_REGION0";
mpu_armv71.size              = 31;
mpu_armv71.attributes        = "Device";
mpu_armv71.accessPermissions = "Supervisor RD+WR, User RD";
mpu_armv71.allowExecute      = false;

mpu_armv72.$name             = "CONFIG_MPU_REGION1";
mpu_armv72.size              = 15;
mpu_armv72.accessPermissions = "Supervisor RD+WR, User RD";

mpu_armv73.$name             = "CONFIG_MPU_REGION2";
mpu_armv73.baseAddr          = 0x41010000;
mpu_armv73.size              = 15;
mpu_armv73.accessPermissions = "Supervisor RD+WR, User RD";

mpu_armv74.$name             = "CONFIG_MPU_REGION3";
mpu_armv74.baseAddr          = 0x70000000;
mpu_armv74.size              = 21;
mpu_armv74.accessPermissions = "Supervisor RD+WR, User RD";

mpu_armv75.$name    = "CONFIG_MPU_REGION4";
mpu_armv75.size     = 31;
mpu_armv75.baseAddr = 0x80000000;

/**
 * Pinmux solution for unlocked pins/peripherals. This ensures that minor changes to the automatic solver in a future
 * version of the tool will not impact the pinmux you originally saw.  These lines can be completely deleted in order to
 * re-solve from scratch.
 */
flash1.peripheralDriver.OSPI.$suggestSolution      = "OSPI0";
flash1.peripheralDriver.OSPI.CLK.$suggestSolution  = "ball.N20";
flash1.peripheralDriver.OSPI.CSn0.$suggestSolution = "ball.L19";
flash1.peripheralDriver.OSPI.DQS.$suggestSolution  = "ball.N19";
flash1.peripheralDriver.OSPI.D7.$suggestSolution   = "ball.M17";
flash1.peripheralDriver.OSPI.D6.$suggestSolution   = "ball.N18";
flash1.peripheralDriver.OSPI.D5.$suggestSolution   = "ball.P20";
flash1.peripheralDriver.OSPI.D4.$suggestSolution   = "ball.P21";
flash1.peripheralDriver.OSPI.D3.$suggestSolution   = "ball.M21";
flash1.peripheralDriver.OSPI.D2.$suggestSolution   = "ball.M20";
flash1.peripheralDriver.OSPI.D1.$suggestSolution   = "ball.M18";
flash1.peripheralDriver.OSPI.D0.$suggestSolution   = "ball.M19";
mmcsd1.MMC0.$suggestSolution                       = "MMC0";
uart1.UART.$suggestSolution                        = "USART0";
uart1.UART.RXD.$suggestSolution                    = "ball.D15";
uart1.UART.TXD.$suggestSolution                    = "ball.C16";
